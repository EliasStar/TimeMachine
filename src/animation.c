#include <animation.h>

#include <Arduino.h>

#include <utils/pins.h>

const uint8_t remoteSequence[FRAME_COUNT][4] = {
    { 0b10000000, 0b00000000, 0b00000000, 0b00000000 },
    { 0b10000000, 0b10000000, 0b00000000, 0b00000000 },
    { 0b10000000, 0b10000000, 0b10000000, 0b00000000 },
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    { 0b11111100, 0b11111100, 0b11111100, 0b11111100 }
};

const uint8_t localSequence[FRAME_COUNT][4] = {
    { 0b10000000, 0b00000000, 0b00000000, 0b00000000 },
    { 0b11000000, 0b00000000, 0b00000000, 0b00000000 },
    { 0b11001000, 0b00000000, 0b00000000, 0b00000000 },
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    { 0b11111100, 0b11111100, 0b11111100, 0b11111100 }
};

void displayStartUp()
{
    uint8_t ready = 0;

    while (ready == 0)
    {
        digitalWrite(CHANGING_LED_PIN, HIGH);
        delay(500);

        for (int8_t i = INIT_TIME; digitalRead(ENTER_PIN) == LOW; i--)
        {
            digitalWrite(CHANGED_LED_PIN, HIGH);
            delay(100);

            if (i < 0)
            {
                ready = 1;
                break;
            }

            digitalWrite(CHANGED_LED_PIN, LOW);
            delay(100);
        }

        digitalWrite(CHANGING_LED_PIN, LOW);
        delay(500);
    }

    digitalWrite(CHANGED_LED_PIN, HIGH);

    for (int8_t i = 0; i < FRAME_COUNT; i++)
    {
        for (int8_t j = 3; j >= 0; j--)
        {
            shiftOut(LOCAL_DATA_PIN, LOCAL_CLOCK_PIN, MSBFIRST, localSequence[i][j] ^ 0xFF);
            shiftOut(REMOTE_DATA_PIN, REMOTE_CLOCK_PIN, MSBFIRST, remoteSequence[i][j]);
        }

        digitalWrite(LOCAL_LATCH_PIN, HIGH);
        digitalWrite(REMOTE_LATCH_PIN, HIGH);
        digitalWrite(LOCAL_LATCH_PIN, LOW);
        digitalWrite(REMOTE_LATCH_PIN, LOW);

        digitalWrite(CHANGING_LED_PIN, HIGH);
        delay(200);
        digitalWrite(CHANGING_LED_PIN, LOW);
        delay(200);
    }

    digitalWrite(CHANGED_LED_PIN, LOW);
}